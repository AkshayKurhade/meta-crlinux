## conf/layer.conf
```bitbake
# We have a conf and classes directory, add to BBPATH
BBPATH .= ":${LAYERDIR}"

# We have recipes-* directories, add to BBFILES
BBFILES += "${LAYERDIR}/recipes-*/*/*.bb \
${LAYERDIR}/recipes-*/*/*.bbappend"

BBFILE_COLLECTIONS += "crlinux"
BBFILE_PATTERN_crlinux = "^${LAYERDIR}/"
BBFILE_PRIORITY_crlinux = "10"
MACHINE_ESSENTIAL_EXTRA_RDEPENDS += "kernel-module-addi9036"
KERNEL_MODULE_AUTOLOAD += "addi9036"
LAYERSERIES_COMPAT_crlinux = "hardknott" 
```
